// Custom device tree overlay to enable spi0 with suitable pin configuration

/dts-v1/;
/plugin/;

/{
	model = "TI AM335x BeagleBone Black";
	compatible = "ti,beaglebone", "ti,beaglebone-black";
	part-number = "BBB-SPI0";
	version = "00A0";

	fragment@0 {
		target = <&am33xx_pinmux>;

		__overlay__ {
			spi0_pins: pinmux_spi0_pins {
				pinctrl-single,pins = <
					0x150 0x30 /* P9_22 spi0_sclk	INPUT_PULLUP | MODE0 */
					0x154 0x30 /* P9_21 spi0_d0		INPUT_PULLUP | MODE0 */
				>;
			};
		};
	};

	fragment@1 {
		target = <&spi0>;

		__overlay__ {
			#address-cells = <0x1>;
			#size-cells = <0x0>;
			pinctrl-names = "default";
			pinctrl-0 = <&spi0_pins>;
			status = "okay";
		};
	};
};
